## conf/layer.conf
```bitbake
BBPATH .= ":${LAYERDIR}"

BBFILES += "${LAYERDIR}/recipes-*/*/*.bb \
            ${LAYERDIR}/recipes-*/*/*.bbappend"

BBFILE_COLLECTIONS += "auvidea-j120"
BBFILE_PATTERN_auvidea-j120 = "^${LAYERDIR}/"
BBFILE_PRIORITY_auvidea-j120 = "5"
```

## conf/machine/auvidea-j120.conf
```bitbake
#@TYPE: Machine
##@NAME: auvidea-j120
##@DESCRIPTION: Machine configuration for the Auvidea J120 carrier board for the NVIDIA Jetson TX1/TX2

MACHINEOVERRIDES = "jetson-tx2:${MACHINE}"
include conf/machine/jetson-tx2.conf
```
